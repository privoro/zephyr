## drivers/adc/Kconfig.mcux
```kconfig
# ADC configuration options

# Copyright (c) 2015 Intel Corporation
# SPDX-License-Identifier: Apache-2.0

config ADC_MCUX_ADC12
	bool "MCUX ADC12 driver"
	depends on HAS_MCUX_ADC12
	help
	  Enable the MCUX ADC12 driver.

config ADC_MCUX_ADC16
	bool "MCUX ADC16 driver"
	depends on HAS_MCUX_ADC16
	help
	  Enable the MCUX ADC16 driver.

if ADC_MCUX_ADC16

choice
	prompt "Clock Divide Selection"
	default ADC_MCUX_ADC16_CLK_DIV_RATIO_1

config ADC_MCUX_ADC16_CLK_DIV_RATIO_1
	bool "Divide ratio is 1"

config ADC_MCUX_ADC16_CLK_DIV_RATIO_2
	bool "Divide ratio is 2"

config ADC_MCUX_ADC16_CLK_DIV_RATIO_4
	bool "Divide ratio is 4"

config ADC_MCUX_ADC16_CLK_DIV_RATIO_8
	bool "Divide ratio is 8"

endchoice

choice ADC_MCUX_ADC16_VREF
	prompt "Voltage Reference Selection"
	default ADC_MCUX_ADC16_VREF_DEFAULT

config ADC_MCUX_ADC16_VREF_DEFAULT
	bool "Default voltage reference pair V_REFH and V_REFL"

config ADC_MCUX_ADC16_VREF_ALTERNATE
	bool "Alternate reference pair"

endchoice

config ADC_EDMA_CHANNEL
	int "ADC DMA Channel select"
	depends on HAS_MCUX_EDMA
	default 0
	help
	  ADC DMA Channel select (0-4) PIT triggerred

config ADC_HW_TRIGGER
	bool "ADC HW TRIGGER"
	default true
	help
	  Support HW Trigger ADC

if ADC_HW_TRIGGER

config ADC_HW_TRIGGER_CHANNEL
	int "HW trigger ADC channel"
	default 4
	help
	  hw channel id as trigger source default PIT0

endif # ADC_PIT_TRIGGER

endif # ADC_MCUX_ADC16
```

## drivers/counter/Kconfig.mcux_pit
```kconfig
# MCUXpresso SDK Periodic Interrupt Timer (PIT)

# Copyright (c) 2020 NXP Semiconductor INC.
# SPDX-License-Identifier: Apache-2.0

config COUNTER_MCUX_PIT
	bool "MCUX PIT driver"
	depends on HAS_MCUX_PIT
	help
	  Enable support for the MCUX Periodic Interrupt Timer (PIT).

if COUNTER_MCUX_PIT

config PIT_CHANNEL
    int "pit channel"
    default 0
    help
      pit channel id

endif # COUNTER_MCUX_PIT
```

## dts/bindings/timer/nxp,kinetis-pit.yaml
```yaml
# Copyright (c) 2020 NXP Semiconductor INC.
# SPDX-License-Identifier: Apache-2.0

description: NXP MCUX Periodic Interrupt Timer (PIT)

compatible: "nxp,kinetis-pit"

include: [base.yaml]

properties:
    reg:
      required: true

    interrupts:
      required: true

    label:
      required: true
```

## tests/drivers/adc/adc_dma/testcase.yaml
```yaml
common:
  tags: adc dma trigger
tests:
  drivers.adc-dma:
    depends_on: adc && dma && pit
    platform_whitelist: frdm_k82f
```
